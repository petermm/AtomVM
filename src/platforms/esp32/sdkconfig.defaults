## src/platforms/esp32/sdkconfig.defaults
```kconfig
CONFIG_PARTITION_TABLE_CUSTOM=y
CONFIG_ESPTOOLPY_FLASHSIZE_4MB=y
CONFIG_MBEDTLS_ECP_FIXED_POINT_OPTIM=y
CONFIG_MBEDTLS_SSL_PROTO_TLS1_3=y
CONFIG_MBEDTLS_SSL_KEEP_PEER_CERTIFICATE=y
```

## src/platforms/esp32/sdkconfig.defaults.esp32s2
```kconfig
# SPDX-License-Identifier: Apache-2.0
# SPDX-FileCopyrightText: AtomVM Contributors
#

CONFIG_USE_USB_SERIAL=y
```
