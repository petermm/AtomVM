## src/platforms/esp32/main/Kconfig.projbuild
```kconfig
#
## This file is part of AtomVM.
##
## Copyright 2022 Fred Dushin <fred@dushin.net>
##
## Licensed under the Apache License, Version 2.0 (the "License");
## you may not use this file except in compliance with the License.
## You may obtain a copy of the License at
##
##    http://www.apache.org/licenses/LICENSE-2.0
##
## Unless required by applicable law or agreed to in writing, software
## distributed under the License is distributed on an "AS IS" BASIS,
## WITHOUT WARRANTIES OR CONDITIONS OF ANY KIND, either express or implied.
## See the License for the specific language governing permissions and
## limitations under the License.
##
## SPDX-License-Identifier: Apache-2.0 OR LGPL-2.1-or-later
##
#
menu "AtomVM configuration"

    config REBOOT_ON_NOT_OK
        bool  "Reboot on not ok return value from start/0"
        default n
        help
            Reboot the ESP32 device if the start/0 entrypoint does not return the `ok` atom.

     config USE_USB_SERIAL
         bool "Enable USB CDC Serial"
         default n
         select TINYUSB_CDC_ENABLED
         help
             Enable USB CDC Serial functionality.

     config TINYUSB_CDC_ENABLED
         bool "Enable TinyUSB CDC (requires 'idf.py add-dependency esp_tinyusb')"
         default y
         depends on USE_USB_SERIAL
         help
             Enable TinyUSB CDC functionality if USE_USB_SERIAL is enabled.

     config JIT_ENABLED
         bool "Enable just in time compilation"
         default n
         help
             Enable Just in time compilation, or just execution of precompiled native code

    config AVM_DEFAULT_ATOMS_IN_RAM
        bool "Copy default atoms table and strings to RAM at boot"
        default n
        help
            Copy default atoms and strings to RAM at startup instead of reading
            them from Flash. Increases heap usage by ~4-5 KB but improves runtime
            performance by avoiding Flash reads on atom lookups.

    config AVM_LABT
        bool "Use pre-computed LabT flash tables for BEAM labels"
        default n
        help
            Use pre-computed LabT (Label Table) chunk in Flash for bytecode label
            jump tables instead of scanning instructions and building the label table
            in RAM at module load time. Saves ~22-28 KB DRAM across loaded modules,
            but label lookups during execution read from Flash.

    config AVM_IRAM_HOT
        bool "Place hot VM code in IRAM"
        default n
        help
            Move hot VM code from Flash into instruction RAM so it no longer
            consumes the shared 16 KB Flash cache. Costs a few KB of IRAM, which on
            chips where IRAM and DRAM share the same SRAM (ESP32-C3) reduces the
            available heap by the same amount. Select below which parts to move.

    config AVM_IRAM_HOT_GC
        bool "  garbage collector hot path"
        depends on AVM_IRAM_HOT
        default y
        help
            Place the GC hot path (memory_gc, memory_ensure_free_with_roots,
            memory_scan_and_copy, memory_shallow_copy_term) in IRAM.

    config AVM_IRAM_HOT_BIFS
        bool "  integer arithmetic and bitwise BIFs"
        depends on AVM_IRAM_HOT
        default y
        help
            Place the Erlang integer arithmetic and bitwise BIFs
            (+ - * div rem fdiv neg abs band bor bxor bnot bsl bsr) in IRAM.

    config AVM_IRAM_HOT_VM
        bool "  VM hot path (term_compare, scheduler, mailbox)"
        depends on AVM_IRAM_HOT
        default y
        help
            Place term_compare (used by select_val, comparisons and map
            lookups), scheduler_run and mailbox_process_outer_list in IRAM.

    config AVM_CREATE_STACKTRACES
        bool  "Create BEAM stack traces."
        default y
        help
            Create stacktraces for AtomVM application debugging, when an application crashes a stacktrace will be emitted.

    config AVM_VERBOSE_ABORT
        bool  "Verbose error when a VM abort occurs."
        default n
        help
            Print the C module and line number when a VM abort occurs.

    config ENABLE_REALLOC_GC
        bool  "Enable experimental optimized realloc garbage collection."
        default n
        help
            Enable experimental optimized garbage collection mode that makes use of C realloc instead of copying data.

    config AVM_BOOT_STATS
        bool  "Log boot time and free heap at startup."
        default n
        help
            Log the time since boot and the free heap at the beginning of app_main,
            and again once the startup module has been loaded, right before it is
            run.

    config AVM_BOOT_STATS_LOADALL
        bool  "Preload the whole AVM pack when logging boot stats."
        default n
        depends on AVM_BOOT_STATS
        help
            Preload every module of the startup AVM, so that the boot stats report
            the cost of the fully loaded AtomVM runtime instead of just the startup
            module.

endmenu
```
